## Documentation/devicetree/bindings/display/panel/samsung,amb655uv01.yaml
```yaml
# SPDX-License-Identifier: (GPL-2.0-only OR BSD-2-Clause)
%YAML 1.2
---
$id: http://devicetree.org/schemas/display/panel/samsung,amb655uv01.yaml#
$schema: http://devicetree.org/meta-schemas/core.yaml#

title: Samsung AMB655UV01 1080x2400 AMOLED panel

maintainers:
  - Caleb Connolly <caleb@postmarketos.org>

allOf:
  - $ref: panel-common.yaml#

properties:
  compatible:
    const: samsung,amb655uv01

  vddr-supply:
    description: Panel 1.3 V internal digital regulator supply.

  vddd-supply:
    description: Panel digital-power enable supply; may share a regulator owner.

  reg:
    maxItems: 1

  reset-gpios:
    maxItems: 1
    description: Active-low panel reset.

  vddio-supply: true
  vci-supply: true
  port: true

required:
  - compatible
  - reg
  - vci-supply
  - vddr-supply
  - vddd-supply
  - reset-gpios
  - vddio-supply

additionalProperties: false

examples:
  - |
    #include <dt-bindings/gpio/gpio.h>
    dsi {
        #address-cells = <1>;
        #size-cells = <0>;

        panel@0 {
            reg = <0>;
            compatible = "samsung,amb655uv01";
            vddio-supply = <&vreg_l14a_1p8>;
            vci-supply = <&vreg_l11c_3p3>;
            vddr-supply = <&vreg_l2c_1p2>;
            vddd-supply = <&panel_digital_enable>;
            reset-gpios = <&tlmm 75 GPIO_ACTIVE_LOW>;

            port {
                panel_in_0: endpoint {
                    remote-endpoint = <&mdss_dsi0_out>;
                };
            };
        };
    };
...
```

## Documentation/devicetree/bindings/display/panel/samsung,amb655x.yaml
```yaml
# SPDX-License-Identifier: (GPL-2.0-only OR BSD-2-Clause)
%YAML 1.2
---
$id: http://devicetree.org/schemas/display/panel/samsung,amb655x.yaml#
$schema: http://devicetree.org/meta-schemas/core.yaml#

title: Samsung AMB655X 1080x2400 AMOLED panel

maintainers:
  - Caleb Connolly <caleb@postmarketos.org>

allOf:
  - $ref: panel-common.yaml#

properties:
  compatible:
    enum:
      - samsung,amb655x
      - samsung,amb655uv01

  vddr-supply:
    description: Panel1.3V internal digital regulator supply.

  vddd-supply:
    description: Panel digital-power enable supply; may share a regulator owner.

  oneplus,keep-dsc-on-blank:
    type: boolean
    description: |
      Retain the initialized DSC receiver when blanking using DCS display
      off/on. The board does not cycle AVDD during a normal display blank.

  reg:
    maxItems: 1

  reset-gpios:
    description: reset gpio, must be GPIO_ACTIVE_LOW

  vddio-supply: true
  vdd-supply: true
  avdd-supply: true
  enable-gpios: true
  port: true

required:
  - compatible
  - reg
  - vdd-supply
  - avdd-supply
  - vddio-supply

additionalProperties: false

examples:
  - |
    #include <dt-bindings/gpio/gpio.h>
    dsi {
        #address-cells = <1>;
        #size-cells = <0>;

        panel@0 {
            reg = <0>;
            compatible = "samsung,amb655uv01";
            vddio-supply = <&vreg_l14a_1p8>;
            vdd-supply = <&vreg_l11c_3p3>;
            avdd-supply = <&panel_avdd_5p5>;
            reset-gpios = <&tlmm 75 GPIO_ACTIVE_LOW>;

            port {
                panel_in_0: endpoint {
                    remote-endpoint = <&mdss_dsi0_out>;
                };
            };
        };
    };
...
```
